## subsys/dfu/fmfu_fdev/Kconfig
```kconfig
#
# Copyright (c) 2020 Nordic Semiconductor ASA
#
# SPDX-License-Identifier: LicenseRef-BSD-5-Clause-Nordic
#

menuconfig FMFU_FDEV
	bool "Full Modem Firmware Upgrade from flash device"
	depends on CDDL_GEN


if (FMFU_FDEV)

config MBEDTLS_HEAP_SIZE
	int
	default 4096

module=FMFU_FDEV
module-dep=LOG
module-str=FMFU FDEV
source "${ZEPHYR_BASE}/subsys/logging/Kconfig.template.log_config"

endif # FMFU_FDEV
```

## subsys/dfu/mfu_ext/Kconfig
```kconfig
#
# Copyright (c) 2020 Nordic Semiconductor ASA
#
# SPDX-License-Identifier: LicenseRef-BSD-5-Clause-Nordic
#

menuconfig MFU_EXT
	bool "Modem Firmware Upgrade from external flash"
	select NORDIC_SECURITY_BACKEND
	select CC3XX_BACKEND
	select MBEDTLS_ENABLE_HEAP
	select CDDL_GEN


if (MFU_EXT)

config MBEDTLS_HEAP_SIZE
	int
	default 4096

module=MFU_EXT
module-dep=LOG
module-str=MFU EXT
source "${ZEPHYR_BASE}/subsys/logging/Kconfig.template.log_config"

endif #MFU_EXT
```

## subsys/mgmt/fmfu/Kconfig
```kconfig
#
# Copyright (c) 2020 Nordic Semiconductor ASA
#
# SPDX-License-Identifier: LicenseRef-BSD-5-Clause-Nordic
#

menu "Full Modem Firmware Update Management(FMFU)"

config MGMT_FMFU
	bool "Serial Modem Firmware Update support"
	depends on MCUMGR_SMP_UART
	depends on MCUMGR
	depends on SOC_NRF9160_SICA

module=MGMT_FMFU
module-dep=LOG
module-str=FMFU
source "${ZEPHYR_BASE}/subsys/logging/Kconfig.template.log_config"
endmenu
```

## subsys/mgmt/mfu/Kconfig
```kconfig
#
# Copyright (c) 2020 Nordic Semiconductor ASA
#
# SPDX-License-Identifier: LicenseRef-BSD-5-Clause-Nordic
#

menu "Modem Firmware Update (MFU)"

config MGMT_MFU
	bool "Serial Modem Firmware Update support"
	depends on MCUMGR_SMP_UART
	depends on MCUMGR
	depends on SOC_NRF9160_SICA

module=MGMT_MFU
module-dep=LOG
module-str=MFU
source "${ZEPHYR_BASE}/subsys/logging/Kconfig.template.log_config"
```

## tests/subsys/dfu/dfu_target_stream/testcase.yaml
```yaml
tests:
  dfu.target_stream:
    platform_allow: native_posix native_posix_64 nrf52840dk_nrf52840 nrf9160dk_nrf9160ns
    tags: target_stream
  dfu.target_stream.store_progress:
    platform_allow: native_posix native_posix_64 nrf52840dk_nrf52840 nrf9160dk_nrf9160ns
    tags: target_stream
    extra_args: OVERLAY_CONFIG=overlay-store-progress.conf
```

## tests/subsys/dfu/mfu_ext/testcase.yaml
```yaml
tests:
  dfu.mfu_ext:
    platform_allow: native_posix nrf9160dk_nrf9160
    tags: dfu mfu_ext
    # TODO add overlay for 9160 with DK
    # and add support for that as well
```
