## CMakeLists.txt
```
#
# Copyright (c) 2020 Nordic Semiconductor
#
# SPDX-License-Identifier: LicenseRef-BSD-5-Clause-Nordic
#

cmake_minimum_required(VERSION 3.13.1)

find_package(Zephyr REQUIRED HINTS $ENV{ZEPHYR_BASE})
project(smp_fmfu_svr)

target_sources(app PRIVATE src/main.c)
```

## sample.yaml
```
sample:
  description: Full modem Simple Management Protocol sample
  name: fmfu smp svr
tests:
  sample.mcumg.smp_svr.nrf91:
    platform_whitelist: nrf9160dk_nrf9160ns 
```

## prj.conf
```kconfig
#
# Copyright (c) 2020 Nordic Semiconductor ASA
#
# SPDX-License-Identifier: LicenseRef-BSD-5-Clause-Nordic
#

# Enable mcumgr.
CONFIG_MCUMGR=y

# Some command handlers require a large stack.
CONFIG_SYSTEM_WORKQUEUE_STACK_SIZE=2048

# Ensure an MCUboot-compatible binary is generated.
CONFIG_BOOTLOADER_MCUBOOT=y

# Enable the UART mcumgr transports.
CONFIG_MCUMGR_SMP_UART=y
CONFIG_UART_MCUMGR_RX_BUF_SIZE=512
CONFIG_MCUMGR_BUF_SIZE=512

# Required by the `taskstat` command.
CONFIG_THREAD_MONITOR=y

# Enable statistics and statistic names.
CONFIG_STATS=y
CONFIG_STATS_NAMES=y

# Enable STAT and OS from the core commands
CONFIG_MGMT_FMFU=y
CONFIG_MCUMGR_CMD_OS_MGMT=y
CONFIG_MCUMGR_CMD_STAT_MGMT=y

CONFIG_NRF_MODEM_LIB=y
CONFIG_NRF_MODEM_LIB_SYS_INIT=y
CONFIG_NRF_MODEM_BUILD_FROM_SRC=y
CONFIG_AT_CMD=y
CONFIG_AT_CMD_PARSER=y
CONFIG_AT_CMD_SYS_INIT=y
CONFIG_MODEM_INFO=y

CONFIG_NETWORKING=y
CONFIG_NET_SOCKETS=y
CONFIG_NET_SOCKETS_OFFLOAD=y
CONFIG_HEAP_MEM_POOL_SIZE=8192
CONFIG_SPEED_OPTIMIZATIONS=y

# RTT Logging since you cannot use the UART as it is used for SMP
CONFIG_USE_SEGGER_RTT=y
CONFIG_LOG_BACKEND_RTT=y
CONFIG_LOG=y
CONFIG_LOG_PRINTK=y
CONFIG_LOG_IMMEDIATE=y
CONFIG_LOG_BUFFER_SIZE=1024
CONFIG_LOG_BACKEND_UART=n
CONFIG_MGMT_FMFU_LOG_LEVEL_DBG=y
#CONFIG_LOG_DEFAULT_LEVEL=4
#CONFIG_LOG_OVERRIDE_LEVEL=4

CONFIG_NRF_MODEM_LIB_SHMEM_RX_SIZE=9000
#CONFIG_FULL_DFU=n
```

## src/main.c
```c
/*
 * Copyright (c) 2020 Nordic Semiconductor ASA
 *
 * SPDX-License-Identifier: LicenseRef-BSD-5-Clause-Nordic
 */

#include <zephyr.h>
#include <mgmt/mgmt_fmfu.h>
#include <mgmt/mgmt_fmfu_stat.h>
#include <modem/modem_info.h>
#include <modem/nrf_modem_lib.h>
#include <modem/at_cmd.h>

void main(void)
{

	char modem_version[36];
	modem_info_init();
	modem_info_string_get(MODEM_INFO_FW_VERSION, modem_version, 36);
	printk("Starting modem mgmt sample\n\r");
	printk("Modem version: %s\n\r", modem_version);

	/* Shutdown modem to prepare for DFU */
	nrf_modem_lib_shutdown();
	nrf_modem_lib_init(FULL_DFU_MODE);
	/* Register SMP Communication stats */
	mgmt_fmfu_stat_init();
	/* Initialize MCUMgr handlers for full modem update */
	int err = mgmt_fmfu_init();
	if (err) {
		printk("Error in init fmfu: %d\n\r", err);
	}
	printk("FMFU initialized ready to receive firmware\n\r");
	while (1) {
		k_cpu_idle();
	}
}
```
